/**
 * @cliArgs --device "F2838x" --package "337bga" --part "F2838x_337bga" --context "CPU1" --product "C2000WARE@5.02.00.00"
 * @versions {"tool":"1.20.0+3587"}
 */

/**
 * Import the modules used in this configuration.
 */
const clb                              = scripting.addModule("/driverlib/clb.js", {}, false);
const clb1                             = clb.addInstance();
const clb2                             = clb.addInstance();
const clb3                             = clb.addInstance();
const clb_inputxbar_input              = scripting.addModule("/driverlib/clb_inputxbar_input.js", {}, false);
const clb_inputxbar_input1             = clb_inputxbar_input.addInstance();
const clb_outputxbar                   = scripting.addModule("/driverlib/clb_outputxbar.js", {}, false);
const clb_outputxbar1                  = clb_outputxbar.addInstance();
const TILE                             = scripting.addModule("/utilities/clb_tool/clb_syscfg/source/TILE");
const TILE1                            = TILE.addInstance();
const TILE2                            = TILE.addInstance();
const TILE3                            = TILE.addInstance();
const clb_run_dynamic_template_clb_c   = scripting.addModule("/utilities/clb_tool/clb_syscfg/source/clb_run_dynamic_template_clb_c.js");
const clb_run_dynamic_template_clb_dot = scripting.addModule("/utilities/clb_tool/clb_syscfg/source/clb_run_dynamic_template_clb_dot.js");
const clb_run_dynamic_template_clb_h   = scripting.addModule("/utilities/clb_tool/clb_syscfg/source/clb_run_dynamic_template_clb_h.js");
const clb_run_dynamic_template_clb_sim = scripting.addModule("/utilities/clb_tool/clb_syscfg/source/clb_run_dynamic_template_clb_sim.js");

/**
 * Write custom configuration values to the imported modules.
 */
clb1.attachTile                 = true;
clb1.inputTypeCLB_IN0           = "LOCAL";
clb1.localConfigCLB_IN0         = "CLB_LOCAL_IN_MUX_INPUT1";
clb1.localConfigCLB_IN1         = "CLB_LOCAL_IN_MUX_INPUT2";
clb1.synchronizeCLB_IN1         = true;
clb1.initTile                   = true;
clb1.$name                      = "RS485_RX_TX_CLB_EOT";
clb1.inputPipelineConfigCLB_IN2 = true;
clb1.inputTypeCLB_IN4           = "GLOBAL";
clb1.inputTypeCLB_IN3           = "GLOBAL";
clb1.synchronizeCLB_IN0         = true;
clb1.inputPipelineConfigCLB_IN3 = true;
clb1.inputPipelineConfigCLB_IN4 = true;
clb1.globalConfigCLB_IN4        = "CLB_GLOBAL_IN_MUX_CLB2_OUT21";
clb1.inputPipelineConfigCLB_IN1 = true;
clb1.inputTypeCLB_IN2           = "GLOBAL";
clb1.globalConfigCLB_IN2        = "CLB_GLOBAL_IN_MUX_CLB2_OUT20";
clb1.globalConfigCLB_IN3        = "CLB_GLOBAL_IN_MUX_CLB2_OUT21";
clb1.inputsUsed                 = ["CLB_IN0","CLB_IN1","CLB_IN2","CLB_IN3"];

clb2.inputTypeCLB_IN0           = "LOCAL";
clb2.synchronizeCLB_IN0         = true;
clb2.localConfigCLB_IN0         = "CLB_LOCAL_IN_MUX_INPUT1";
clb2.attachTile                 = true;
clb2.initTile                   = true;
clb2.$name                      = "RS485_RX_CLB_ADDR_VALID";
clb2.inputsUsed                 = ["CLB_IN0","CLB_IN1"];
clb2.inputTypeCLB_IN1           = "GLOBAL";
clb2.inputPipelineConfigCLB_IN1 = true;
clb2.globalConfigCLB_IN1        = "CLB_GLOBAL_IN_MUX_CLB1_OUT20";
clb2.clbBase                    = "CLB2_BASE";

clb3.$name                       = "RS485_TX_CLB_INVERT";
clb3.clbBase                     = "CLB7_BASE";
clb3.outputsToOverridePeripheral = ["CLB_OUT0"];
clb3.inputsUsed                  = ["CLB_IN0"];
clb3.inputTypeCLB_IN0            = "LOCAL";
clb3.localConfigCLB_IN0          = "CLB_LOCAL_IN_MUX_SCI_TX";
clb3.synchronizeCLB_IN0          = true;
clb3.attachTile                  = true;
clb3.initTile                    = true;

clb_inputxbar_input1.inputxbarGpio = "GPIO13";
clb_inputxbar_input1.$name         = "SCI_RX_CLB_INPUT_XBAR_IN1";

clb_outputxbar1.muxesUsed                                = ["XBAR_MUX00"];
clb_outputxbar1.$name                                    = "THVD_TX_EN_CLB_OUTPUT_XBAR0";
clb_outputxbar1.clb_outputxbar.$assign                   = "CLB_OUTPUTXBAR4";
clb_outputxbar1.clb_outputxbar.clb_outputxbarPin.$assign = "GPIO94";

TILE.generateSimulation = true;
TILE.clock_period       = 10000;
TILE.reset_duration     = 400000;
TILE.sim_duration       = 150000000;

clb1.tile                          = TILE1;
TILE1.$name                        = "TILE1";
TILE1.BOUNDARY.$name               = "BOUNDARY0";
TILE1.BOUNDARY.boundaryInput0      = "customWave";
TILE1.BOUNDARY.boundaryInput3      = "tileOutput";
TILE1.BOUNDARY.tileSelect3         = "TILE2";
TILE1.BOUNDARY.input_pipeline4     = true;
TILE1.BOUNDARY.tileSelect4         = "TILE2";
TILE1.BOUNDARY.tileOutputSelect4   = 5;
TILE1.BOUNDARY.input_pipeline3     = true;
TILE1.BOUNDARY.boundaryInput1      = "customWave";
TILE1.BOUNDARY.in_custom_source2   = "low(5950)\nhigh(8)\nlow(1000)";
TILE1.BOUNDARY.in_custom_source1   = "low(5950)\nhigh(8)\nlow(1000)";
TILE1.BOUNDARY.boundaryInput2      = "tileOutput";
TILE1.BOUNDARY.input_pipeline2     = true;
TILE1.BOUNDARY.tileSelect2         = "TILE2";
TILE1.BOUNDARY.tileOutputSelect2   = 4;
TILE1.BOUNDARY.tileOutputSelect3   = 5;
TILE1.BOUNDARY.in_custom_source0   = "high(200)\n\nlow(8)\nhigh(8)\nlow(8)\nlow(8)\nlow(8)\nlow(8)\nhigh(8)\nhigh(8)\nlow(8)\nhigh(8)\n\nrpt(3)\nlow(8)\nhigh(8)\nlow(8)\nlow(8)\nlow(8)\nlow(8)\nhigh(8)\nhigh(8)\nlow(8)\nhigh(8)\n\nlow(8)\nlow(8)\nhigh(8)\nlow(8)\nlow(8)\nlow(8)\nhigh(8)\nhigh(8)\nlow(8)\nhigh(8)\n\nlow(8)\nhigh(8)\nhigh(8)\nlow(8)\nlow(8)\nlow(8)\nhigh(8)\nhigh(8)\nlow(8)\nhigh(8)\n\nlow(8)\nlow(8)\nlow(8)\nhigh(8)\nlow(8)\nlow(8)\nhigh(8)\nhigh(8)\nlow(8)\nhigh(8)\n\nlow(8)\nhigh(8)\nlow(8)\nhigh(8)\nlow(8)\nlow(8)\nhigh(8)\nhigh(8)\nlow(8)\nhigh(8)\n\nlow(8)\nlow(8)\nhigh(8)\nhigh(8)\nlow(8)\nlow(8)\nhigh(8)\nhigh(8)\nlow(8)\nhigh(8)\n\nlow(8)\nhigh(8)\nhigh(8)\nhigh(8)\nlow(8)\nlow(8)\nhigh(8)\nhigh(8)\nlow(8)\nhigh(8)\n\nlow(8)\nlow(8)\nlow(8)\nlow(8)\nhigh(8)\nlow(8)\nhigh(8)\nhigh(8)\nlow(8)\nhigh(8)\n\nlow(8)\nhigh(8)\nlow(8)\nlow(8)\nhigh(8)\nlow(8)\nhigh(8)\nhigh(8)\nlow(8)\nhigh(8)\n\nlow(8)\nlow(8)\nlow(8)\nlow(8)\nlow(8)\nlow(8)\nhigh(8)\nhigh(8)\nlow(8)\nhigh(8)\nrpt_end\n\nlow(8)\nhigh(8)\nlow(8)\nlow(8)\nlow(8)\nlow(8)\nhigh(8)\nhigh(8)\nlow(8)\nhigh(8)\n\nlow(8)\nhigh(8)\nlow(8)\nhigh(8)\nhigh(8)\nlow(8)\nlow(8)\nlow(8)\nlow(8)\nhigh(8)\n\nlow(8)\nlow(8)\nhigh(8)\nlow(8)\nhigh(8)\nlow(8)\nlow(8)\nlow(8)\nlow(8)\nhigh(8)\n\nhigh(200)\n\nlow(8)\nlow(8)\nhigh(8)\nlow(8)\nlow(8)\nlow(8)\nlow(8)\nhigh(8)\nlow(8)\nhigh(8)\n\nrpt(3)\nlow(8)\nhigh(8)\nlow(8)\nlow(8)\nlow(8)\nlow(8)\nhigh(8)\nhigh(8)\nlow(8)\nhigh(8)\n\nlow(8)\nlow(8)\nhigh(8)\nlow(8)\nlow(8)\nlow(8)\nhigh(8)\nhigh(8)\nlow(8)\nhigh(8)\n\nlow(8)\nhigh(8)\nhigh(8)\nlow(8)\nlow(8)\nlow(8)\nhigh(8)\nhigh(8)\nlow(8)\nhigh(8)\n\nlow(8)\nlow(8)\nlow(8)\nhigh(8)\nlow(8)\nlow(8)\nhigh(8)\nhigh(8)\nlow(8)\nhigh(8)\n\nlow(8)\nhigh(8)\nlow(8)\nhigh(8)\nlow(8)\nlow(8)\nhigh(8)\nhigh(8)\nlow(8)\nhigh(8)\n\nlow(8)\nlow(8)\nhigh(8)\nhigh(8)\nlow(8)\nlow(8)\nhigh(8)\nhigh(8)\nlow(8)\nhigh(8)\n\nlow(8)\nhigh(8)\nhigh(8)\nhigh(8)\nlow(8)\nlow(8)\nhigh(8)\nhigh(8)\nlow(8)\nhigh(8)\n\nlow(8)\nlow(8)\nlow(8)\nlow(8)\nhigh(8)\nlow(8)\nhigh(8)\nhigh(8)\nlow(8)\nhigh(8)\n\nlow(8)\nhigh(8)\nlow(8)\nlow(8)\nhigh(8)\nlow(8)\nhigh(8)\nhigh(8)\nlow(8)\nhigh(8)\n\nlow(8)\nlow(8)\nlow(8)\nlow(8)\nlow(8)\nlow(8)\nhigh(8)\nhigh(8)\nlow(8)\nhigh(8)\nrpt_end\n\nlow(8)\nhigh(8)\nlow(8)\nlow(8)\nlow(8)\nlow(8)\nhigh(8)\nhigh(8)\nlow(8)\nhigh(8)\n\nlow(8)\nhigh(8)\nlow(8)\nhigh(8)\nhigh(8)\nlow(8)\nlow(8)\nlow(8)\nlow(8)\nhigh(8)\n\nlow(8)\nlow(8)\nhigh(8)\nlow(8)\nhigh(8)\nlow(8)\nlow(8)\nlow(8)\nlow(8)\nhigh(8)\n\nhigh(200)\n\nlow(8)\nhigh(8)\nhigh(8)\nhigh(8)\nhigh(8)\nhigh(8)\nhigh(8)\nhigh(8)\nhigh(8)\nhigh(8)\n\nrpt(3)\nlow(8)\nhigh(8)\nlow(8)\nlow(8)\nhigh(8)\nlow(8)\nlow(8)\nhigh(8)\nlow(8)\nhigh(8)\n\nlow(8)\nlow(8)\nhigh(8)\nlow(8)\nlow(8)\nlow(8)\nhigh(8)\nhigh(8)\nlow(8)\nhigh(8)\n\nlow(8)\nhigh(8)\nhigh(8)\nlow(8)\nlow(8)\nlow(8)\nhigh(8)\nhigh(8)\nlow(8)\nhigh(8)\n\nlow(8)\nlow(8)\nlow(8)\nhigh(8)\nlow(8)\nlow(8)\nhigh(8)\nhigh(8)\nlow(8)\nhigh(8)\n\nlow(8)\nhigh(8)\nlow(8)\nhigh(8)\nlow(8)\nlow(8)\nhigh(8)\nhigh(8)\nlow(8)\nhigh(8)\n\nlow(8)\nlow(8)\nhigh(8)\nhigh(8)\nlow(8)\nlow(8)\nhigh(8)\nhigh(8)\nlow(8)\nhigh(8)\n\nlow(8)\nhigh(8)\nhigh(8)\nhigh(8)\nlow(8)\nlow(8)\nhigh(8)\nhigh(8)\nlow(8)\nhigh(8)\n\nlow(8)\nlow(8)\nlow(8)\nlow(8)\nhigh(8)\nlow(8)\nhigh(8)\nhigh(8)\nlow(8)\nhigh(8)\n\nlow(8)\nhigh(8)\nlow(8)\nlow(8)\nhigh(8)\nlow(8)\nhigh(8)\nhigh(8)\nlow(8)\nhigh(8)\n\nlow(8)\nlow(8)\nlow(8)\nlow(8)\nlow(8)\nlow(8)\nhigh(8)\nhigh(8)\nlow(8)\nhigh(8)\nrpt_end\n\nlow(8)\nhigh(8)\nlow(8)\nlow(8)\nlow(8)\nlow(8)\nhigh(8)\nhigh(8)\nlow(8)\nhigh(8)\n\nlow(8)\nhigh(8)\nlow(8)\nhigh(8)\nhigh(8)\nlow(8)\nlow(8)\nlow(8)\nlow(8)\nhigh(8)\n\nlow(8)\nlow(8)\nhigh(8)\nlow(8)\nhigh(8)\nlow(8)\nlow(8)\nlow(8)\nlow(8)\nhigh(8)\n\nhigh(200)\n\nrpt(500)\nlow(8)\nrpt_end\n\nhigh(200)";
TILE1.LUT_0.$name                  = "LUT_0";
TILE1.LUT_0.i0                     = "BOUNDARY.in0";
TILE1.LUT_0.lutDescription         = "RS485_RxTx_LUT_RESET_COUNTER";
TILE1.LUT_0.i1                     = "COUNTER_0.count_match1";
TILE1.LUT_0.eqn                    = "(!i0) | i1";
TILE1.LUT_1.$name                  = "LUT_1";
TILE1.LUT_2.$name                  = "LUT_2";
TILE1.FSM_0.$name                  = "FSM_0";
TILE1.FSM_0.e0                     = "LUT_0.OUT";
TILE1.FSM_0.eqn_s0                 = "((!s0) & e0) | (s0 & (!e1))";
TILE1.FSM_0.fsmDescription         = "RS485_RxTx_FSM_CNT0_ENABLE";
TILE1.FSM_0.e1                     = "COUNTER_0.count_match1";
TILE1.FSM_1.$name                  = "FSM_1";
TILE1.FSM_1.eqn_s0                 = "((!s0) & e0) | (s0 & (!e1))";
TILE1.FSM_1.fsmDescription         = "RS485_RxTx_FSM_SWITCH";
TILE1.FSM_1.e0                     = "BOUNDARY.in1";
TILE1.FSM_1.e1                     = "COUNTER_0.count_match1";
TILE1.FSM_2.$name                  = "FSM_2";
TILE1.COUNTER_0.$name              = "COUNTER_0";
TILE1.COUNTER_0.mode1              = "1";
TILE1.COUNTER_0.counterDescription = "RS485_Rx_Tx_CNT_EOT_DETECT";
TILE1.COUNTER_0.reset              = "LUT_0.OUT";
TILE1.COUNTER_0.mode0              = "FSM_0.S0";
TILE1.COUNTER_0.match1_val         = "77";
TILE1.COUNTER_0.match2_val         = "";
TILE1.COUNTER_1.$name              = "COUNTER_1";
TILE1.COUNTER_2.$name              = "COUNTER_2";
TILE1.COUNTER_2.serializer_en      = true;
TILE1.OUTLUT_0.$name               = "OUTLUT_0";
TILE1.OUTLUT_0.i0                  = "FSM_1.S0";
TILE1.OUTLUT_0.eqn                 = "i0";
TILE1.OUTLUT_0.outlutDescription   = "RS485_RxTx_PIN";
TILE1.OUTLUT_1.$name               = "OUTLUT_1";
TILE1.OUTLUT_2.$name               = "OUTLUT_2";
TILE1.OUTLUT_3.$name               = "OUTLUT_3";
TILE1.OUTLUT_4.$name               = "OUTLUT_4";
TILE1.OUTLUT_4.outlutDescription   = "RS485_Rx_EOT_DETECT";
TILE1.OUTLUT_4.eqn                 = "!i0";
TILE1.OUTLUT_4.i0                  = "FSM_0.S0";
TILE1.OUTLUT_5.$name               = "OUTLUT_5";
TILE1.OUTLUT_6.$name               = "OUTLUT_6";
TILE1.OUTLUT_7.$name               = "OUTLUT_7";
TILE1.HLC.$name                    = "HLC_0";
TILE1.HLC.hlcDescription           = "RS485_Rx_Tx_HLC_EOT_IT";
TILE1.HLC.e0                       = "COUNTER_0.count_match1";
TILE1.HLC.e3                       = "BOUNDARY.in3";
TILE1.HLC.e2                       = "BOUNDARY.in2";
TILE1.HLC.program0.$name           = "HLCP_0";
TILE1.HLC.program0.instruct0       = "INTR 0x01";
TILE1.HLC.program1.$name           = "HLCP_1";
TILE1.HLC.program2.$name           = "HLCP_2";
TILE1.HLC.program2.instruct0       = "INTR 0x10";
TILE1.HLC.program3.$name           = "HLCP_3";
TILE1.HLC.program3.instruct0       = "INTR 0x20";
TILE1.AOC_0.$name                  = "AOC_0";
TILE1.AOC_1.$name                  = "AOC_1";
TILE1.AOC_2.$name                  = "AOC_2";
TILE1.AOC_3.$name                  = "AOC_3";
TILE1.AOC_4.$name                  = "AOC_4";
TILE1.AOC_5.$name                  = "AOC_5";
TILE1.AOC_6.$name                  = "AOC_6";
TILE1.AOC_7.$name                  = "AOC_7";

clb2.tile                          = TILE2;
TILE2.$name                        = "TILE2";
TILE2.BOUNDARY.$name               = "BOUNDARY2";
TILE2.BOUNDARY.tileSelect0         = "TILE1";
TILE2.BOUNDARY.tileOutputSelect0   = 2;
TILE2.BOUNDARY.boundaryInput1      = "tileOutput";
TILE2.BOUNDARY.input_pipeline1     = true;
TILE2.BOUNDARY.tileSelect1         = "TILE1";
TILE2.BOUNDARY.boundaryInput0      = "customWave";
TILE2.BOUNDARY.tileOutputSelect1   = 4;
TILE2.BOUNDARY.in_sync1            = true;
TILE2.BOUNDARY.in_custom_source0   = "high(200)\n\nlow(8)\nhigh(8)\nlow(8)\nlow(8)\nlow(8)\nlow(8)\nhigh(8)\nhigh(8)\nlow(8)\nhigh(8)\n\nrpt(3)\nlow(8)\nhigh(8)\nlow(8)\nlow(8)\nlow(8)\nlow(8)\nhigh(8)\nhigh(8)\nlow(8)\nhigh(8)\n\nlow(8)\nlow(8)\nhigh(8)\nlow(8)\nlow(8)\nlow(8)\nhigh(8)\nhigh(8)\nlow(8)\nhigh(8)\n\nlow(8)\nhigh(8)\nhigh(8)\nlow(8)\nlow(8)\nlow(8)\nhigh(8)\nhigh(8)\nlow(8)\nhigh(8)\n\nlow(8)\nlow(8)\nlow(8)\nhigh(8)\nlow(8)\nlow(8)\nhigh(8)\nhigh(8)\nlow(8)\nhigh(8)\n\nlow(8)\nhigh(8)\nlow(8)\nhigh(8)\nlow(8)\nlow(8)\nhigh(8)\nhigh(8)\nlow(8)\nhigh(8)\n\nlow(8)\nlow(8)\nhigh(8)\nhigh(8)\nlow(8)\nlow(8)\nhigh(8)\nhigh(8)\nlow(8)\nhigh(8)\n\nlow(8)\nhigh(8)\nhigh(8)\nhigh(8)\nlow(8)\nlow(8)\nhigh(8)\nhigh(8)\nlow(8)\nhigh(8)\n\nlow(8)\nlow(8)\nlow(8)\nlow(8)\nhigh(8)\nlow(8)\nhigh(8)\nhigh(8)\nlow(8)\nhigh(8)\n\nlow(8)\nhigh(8)\nlow(8)\nlow(8)\nhigh(8)\nlow(8)\nhigh(8)\nhigh(8)\nlow(8)\nhigh(8)\n\nlow(8)\nlow(8)\nlow(8)\nlow(8)\nlow(8)\nlow(8)\nhigh(8)\nhigh(8)\nlow(8)\nhigh(8)\nrpt_end\n\nlow(8)\nhigh(8)\nlow(8)\nlow(8)\nlow(8)\nlow(8)\nhigh(8)\nhigh(8)\nlow(8)\nhigh(8)\n\nlow(8)\nhigh(8)\nlow(8)\nhigh(8)\nhigh(8)\nlow(8)\nlow(8)\nlow(8)\nlow(8)\nhigh(8)\n\nlow(8)\nlow(8)\nhigh(8)\nlow(8)\nhigh(8)\nlow(8)\nlow(8)\nlow(8)\nlow(8)\nhigh(8)\n\nhigh(200)\n\nlow(8)\nlow(8)\nhigh(8)\nlow(8)\nlow(8)\nlow(8)\nlow(8)\nhigh(8)\nlow(8)\nhigh(8)\n\nrpt(3)\nlow(8)\nhigh(8)\nlow(8)\nlow(8)\nlow(8)\nlow(8)\nhigh(8)\nhigh(8)\nlow(8)\nhigh(8)\n\nlow(8)\nlow(8)\nhigh(8)\nlow(8)\nlow(8)\nlow(8)\nhigh(8)\nhigh(8)\nlow(8)\nhigh(8)\n\nlow(8)\nhigh(8)\nhigh(8)\nlow(8)\nlow(8)\nlow(8)\nhigh(8)\nhigh(8)\nlow(8)\nhigh(8)\n\nlow(8)\nlow(8)\nlow(8)\nhigh(8)\nlow(8)\nlow(8)\nhigh(8)\nhigh(8)\nlow(8)\nhigh(8)\n\nlow(8)\nhigh(8)\nlow(8)\nhigh(8)\nlow(8)\nlow(8)\nhigh(8)\nhigh(8)\nlow(8)\nhigh(8)\n\nlow(8)\nlow(8)\nhigh(8)\nhigh(8)\nlow(8)\nlow(8)\nhigh(8)\nhigh(8)\nlow(8)\nhigh(8)\n\nlow(8)\nhigh(8)\nhigh(8)\nhigh(8)\nlow(8)\nlow(8)\nhigh(8)\nhigh(8)\nlow(8)\nhigh(8)\n\nlow(8)\nlow(8)\nlow(8)\nlow(8)\nhigh(8)\nlow(8)\nhigh(8)\nhigh(8)\nlow(8)\nhigh(8)\n\nlow(8)\nhigh(8)\nlow(8)\nlow(8)\nhigh(8)\nlow(8)\nhigh(8)\nhigh(8)\nlow(8)\nhigh(8)\n\nlow(8)\nlow(8)\nlow(8)\nlow(8)\nlow(8)\nlow(8)\nhigh(8)\nhigh(8)\nlow(8)\nhigh(8)\nrpt_end\n\nlow(8)\nhigh(8)\nlow(8)\nlow(8)\nlow(8)\nlow(8)\nhigh(8)\nhigh(8)\nlow(8)\nhigh(8)\n\nlow(8)\nhigh(8)\nlow(8)\nhigh(8)\nhigh(8)\nlow(8)\nlow(8)\nlow(8)\nlow(8)\nhigh(8)\n\nlow(8)\nlow(8)\nhigh(8)\nlow(8)\nhigh(8)\nlow(8)\nlow(8)\nlow(8)\nlow(8)\nhigh(8)\n\nhigh(200)\n\nlow(8)\nhigh(8)\nhigh(8)\nhigh(8)\nhigh(8)\nhigh(8)\nhigh(8)\nhigh(8)\nhigh(8)\nhigh(8)\n\nrpt(3)\nlow(8)\nhigh(8)\nlow(8)\nlow(8)\nhigh(8)\nlow(8)\nlow(8)\nhigh(8)\nlow(8)\nhigh(8)\n\nlow(8)\nlow(8)\nhigh(8)\nlow(8)\nlow(8)\nlow(8)\nhigh(8)\nhigh(8)\nlow(8)\nhigh(8)\n\nlow(8)\nhigh(8)\nhigh(8)\nlow(8)\nlow(8)\nlow(8)\nhigh(8)\nhigh(8)\nlow(8)\nhigh(8)\n\nlow(8)\nlow(8)\nlow(8)\nhigh(8)\nlow(8)\nlow(8)\nhigh(8)\nhigh(8)\nlow(8)\nhigh(8)\n\nlow(8)\nhigh(8)\nlow(8)\nhigh(8)\nlow(8)\nlow(8)\nhigh(8)\nhigh(8)\nlow(8)\nhigh(8)\n\nlow(8)\nlow(8)\nhigh(8)\nhigh(8)\nlow(8)\nlow(8)\nhigh(8)\nhigh(8)\nlow(8)\nhigh(8)\n\nlow(8)\nhigh(8)\nhigh(8)\nhigh(8)\nlow(8)\nlow(8)\nhigh(8)\nhigh(8)\nlow(8)\nhigh(8)\n\nlow(8)\nlow(8)\nlow(8)\nlow(8)\nhigh(8)\nlow(8)\nhigh(8)\nhigh(8)\nlow(8)\nhigh(8)\n\nlow(8)\nhigh(8)\nlow(8)\nlow(8)\nhigh(8)\nlow(8)\nhigh(8)\nhigh(8)\nlow(8)\nhigh(8)\n\nlow(8)\nlow(8)\nlow(8)\nlow(8)\nlow(8)\nlow(8)\nhigh(8)\nhigh(8)\nlow(8)\nhigh(8)\nrpt_end\n\nlow(8)\nhigh(8)\nlow(8)\nlow(8)\nlow(8)\nlow(8)\nhigh(8)\nhigh(8)\nlow(8)\nhigh(8)\n\nlow(8)\nhigh(8)\nlow(8)\nhigh(8)\nhigh(8)\nlow(8)\nlow(8)\nlow(8)\nlow(8)\nhigh(8)\n\nlow(8)\nlow(8)\nhigh(8)\nlow(8)\nhigh(8)\nlow(8)\nlow(8)\nlow(8)\nlow(8)\nhigh(8)\n\nhigh(200)\n\nrpt(500)\nlow(8)\nrpt_end\n\nhigh(200)";
TILE2.LUT_0.$name                  = "LUT_6";
TILE2.LUT_0.lutDescription         = "RS485_LUT_CNT0_RESET";
TILE2.LUT_0.i0                     = "BOUNDARY.in1";
TILE2.LUT_0.eqn                    = "i0 | i1";
TILE2.LUT_0.i1                     = "COUNTER_0.count_match1";
TILE2.LUT_1.$name                  = "LUT_7";
TILE2.LUT_2.$name                  = "LUT_8";
TILE2.FSM_0.$name                  = "FSM_6";
TILE2.FSM_1.$name                  = "FSM_7";
TILE2.FSM_2.$name                  = "FSM_8";
TILE2.COUNTER_0.$name              = "COUNTER_6";
TILE2.COUNTER_0.counterDescription = "RS485_CNT0_CLK_DIVIDER";
TILE2.COUNTER_0.mode0              = "1";
TILE2.COUNTER_0.mode1              = "1";
TILE2.COUNTER_0.match1_val         = "7";
TILE2.COUNTER_0.reset              = "LUT_0.OUT";
TILE2.COUNTER_1.$name              = "COUNTER_7";
TILE2.COUNTER_1.counterDescription = "RS485_CNT1_EVT_CNT";
TILE2.COUNTER_1.mode0              = "COUNTER_0.count_match1";
TILE2.COUNTER_1.mode1              = "1";
TILE2.COUNTER_1.match1_val         = "9";
TILE2.COUNTER_1.match2_val         = "10";
TILE2.COUNTER_1.reset              = "BOUNDARY.in1";
TILE2.COUNTER_2.$name              = "COUNTER_8";
TILE2.COUNTER_2.counterDescription = "RS485_CNT2_ADDR_TEST";
TILE2.COUNTER_2.event              = "BOUNDARY.in0";
TILE2.COUNTER_2.mode0              = "COUNTER_0.count_match1";
TILE2.COUNTER_2.serializer_en      = true;
TILE2.COUNTER_2.action             = "Shift Left";
TILE2.COUNTER_2.reset              = "BOUNDARY.in1";
TILE2.OUTLUT_0.$name               = "OUTLUT_16";
TILE2.OUTLUT_1.$name               = "OUTLUT_17";
TILE2.OUTLUT_2.$name               = "OUTLUT_18";
TILE2.OUTLUT_3.$name               = "OUTLUT_19";
TILE2.OUTLUT_4.$name               = "OUTLUT_20";
TILE2.OUTLUT_4.outlutDescription   = "RS485_ADDR1_VALID";
TILE2.OUTLUT_4.i0                  = "COUNTER_2.count_match1";
TILE2.OUTLUT_4.i1                  = "COUNTER_1.count_match1";
TILE2.OUTLUT_4.i2                  = "1";
TILE2.OUTLUT_4.eqn                 = "i0 & i1";
TILE2.OUTLUT_5.$name               = "OUTLUT_21";
TILE2.OUTLUT_5.outlutDescription   = "RS485_ADDR2_VALID";
TILE2.OUTLUT_5.i0                  = "COUNTER_2.count_match2";
TILE2.OUTLUT_5.i1                  = "COUNTER_1.count_match1";
TILE2.OUTLUT_5.i2                  = "1";
TILE2.OUTLUT_5.eqn                 = "i0 & i1";
TILE2.OUTLUT_6.$name               = "OUTLUT_22";
TILE2.OUTLUT_7.$name               = "OUTLUT_23";
TILE2.HLC.$name                    = "HLC_2";
TILE2.HLC.program0.$name           = "HLCP_8";
TILE2.HLC.program1.$name           = "HLCP_9";
TILE2.HLC.program2.$name           = "HLCP_10";
TILE2.HLC.program3.$name           = "HLCP_11";
TILE2.AOC_0.$name                  = "AOC_16";
TILE2.AOC_1.$name                  = "AOC_17";
TILE2.AOC_2.$name                  = "AOC_18";
TILE2.AOC_3.$name                  = "AOC_19";
TILE2.AOC_4.$name                  = "AOC_20";
TILE2.AOC_5.$name                  = "AOC_21";
TILE2.AOC_6.$name                  = "AOC_22";
TILE2.AOC_7.$name                  = "AOC_23";

clb3.tile                  = TILE3;
TILE3.$name                = "TILE7";
TILE3.BOUNDARY.$name       = "BOUNDARY1";
TILE3.LUT_0.$name          = "LUT_3";
TILE3.LUT_1.$name          = "LUT_4";
TILE3.LUT_2.$name          = "LUT_5";
TILE3.FSM_0.$name          = "FSM_3";
TILE3.FSM_1.$name          = "FSM_4";
TILE3.FSM_2.$name          = "FSM_5";
TILE3.COUNTER_0.$name      = "COUNTER_3";
TILE3.COUNTER_1.$name      = "COUNTER_4";
TILE3.COUNTER_2.$name      = "COUNTER_5";
TILE3.OUTLUT_0.$name       = "OUTLUT_8";
TILE3.OUTLUT_1.$name       = "OUTLUT_9";
TILE3.OUTLUT_2.$name       = "OUTLUT_10";
TILE3.OUTLUT_3.$name       = "OUTLUT_11";
TILE3.OUTLUT_4.$name       = "OUTLUT_12";
TILE3.OUTLUT_5.$name       = "OUTLUT_13";
TILE3.OUTLUT_6.$name       = "OUTLUT_14";
TILE3.OUTLUT_7.$name       = "OUTLUT_15";
TILE3.HLC.$name            = "HLC_1";
TILE3.HLC.program0.$name   = "HLCP_4";
TILE3.HLC.program1.$name   = "HLCP_5";
TILE3.HLC.program2.$name   = "HLCP_6";
TILE3.HLC.program3.$name   = "HLCP_7";
TILE3.AOC_0.$name          = "AOC_8";
TILE3.AOC_0.stage1_mux     = true;
TILE3.AOC_0.aocDescription = "SCI_TX inverter";
TILE3.AOC_0.bypass_mux     = false;
TILE3.AOC_0.input_mode     = "INPUT";
TILE3.AOC_1.$name          = "AOC_9";
TILE3.AOC_2.$name          = "AOC_10";
TILE3.AOC_3.$name          = "AOC_11";
TILE3.AOC_4.$name          = "AOC_12";
TILE3.AOC_5.$name          = "AOC_13";
TILE3.AOC_6.$name          = "AOC_14";
TILE3.AOC_7.$name          = "AOC_15";
