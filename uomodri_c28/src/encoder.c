/***********************************************************************
 * INCLUDE FILES
 ***********************************************************************/
#include "encoder.h"

/***********************************************************************
 * FUNCTIONS DEFINITIONS
 ***********************************************************************/
/**
 * @brief           Reset the ENCODER structure
 * @param[inout]    *p_enc   Pointer on the ENCODER structure to reset.
 */
void ENC_resetStruct(encoder_t* p_enc)
{
    speed_t* p_speed        = &p_enc->speed;

    p_enc->thetaMech[NEW]   = 0.0;
    p_enc->thetaMech[OLD]   = 0.0;
    p_enc->thetaElec        = 0.0;
    p_enc->thetaDir         = 0;

    p_enc->indexCompensated = false;
    p_enc->thetaIndex       = 0.0f;
    p_enc->thetaMechIndexed = 0.0f;
    p_enc->thetaAbsolute    = 0.0f;
    p_enc->turnNb           = 0;
    p_enc->indexDetected    = false;
    p_enc->indexToggle      = false;
    p_enc->rollOverFlag     = false;//p_enc->rollOverFlag;

    p_speed->alpha          = 0.0f;
    p_speed->speedRef       = 0.0f;
    p_speed->theta[NEW]     = 0.0f;
    p_speed->theta[OLD]     = 0.0f;
    p_speed->speedHigh      = 0.0f;
    p_speed->speedLow       = 0.0f;
    p_speed->speedMech      = 0.0f;
    p_speed->speedElec      = 0.0f;
}

/**
 * @brief           Reset ENCODER structure and set EQEP position counter to a defined position (alignment routine)
 * @param[inout]    *p_enc  Pointer on the encoder structure to reset.
 */
inline void ENC_setPosition(encoder_t* p_enc, uint32_t pos)
{
    // Reset encoder position
    EQEP_setPosition(p_enc->p_qepHandle->eqepBase, pos);
    // Reset encoder structure
    ENC_resetStruct(p_enc);
}

/**
 * @brief           Get all the encoder values necessaries for speed, position \& direction computation.
 * @param[inout]    *p_enc  POinter on the encoder structure
 */
inline void ENC_getRegisters(encoder_t* p_enc)
{
    volatile struct EQEP_REGS*  p_qepRegs   = p_enc->p_qepRegs;
    speed_t*                    p_speed     = &p_enc->speed;
    //-------------------------------------------------------------------
    //     POSITION & DIRECTION STROBE
    //-------------------------------------------------------------------
    p_enc->thetaMech[OLD]       = p_enc->thetaMech[NEW];
    // Compute mechanical angle normalized between 0 and 1
    p_enc->thetaMech[NEW]       = (float32_t)(p_qepRegs->QPOSSLAT) / p_enc->thetaMechScaler;
    // Get direction : 0 = CCW/reverse, 1 = CW/forward
    p_enc->thetaDir             = (p_qepRegs->QEPSTS.all & EQEP_STS_DIR_FLAG) ? (1) : (-1);
    //-------------------------------------------------------------------
    //     HIGH SPEED HANDLING
    //-------------------------------------------------------------------
    if(p_qepRegs->QFLG.all & EQEP_INT_UNIT_TIME_OUT)
    {
        p_speed->theta[OLD]     = p_speed->theta[NEW];
        p_speed->theta[NEW]     = (float32_t)(p_qepRegs->QPOSLAT) / p_enc->thetaMechScaler;
        // Clear UTO flag
        p_qepRegs->QCLR.all     = EQEP_INT_UNIT_TIME_OUT | EQEP_INT_OVERFLOW | EQEP_INT_UNDERFLOW;
    }
    //-------------------------------------------------------------------
    //     LOW SPEED HANDLING
    //-------------------------------------------------------------------
    if(p_qepRegs->QEPSTS.all & EQEP_STS_UNIT_POS_EVNT)
    {
        p_speed->speedLow       = (float32_t)(p_enc->thetaDir) * p_speed->speedLowScaler / (float32_t)(p_qepRegs->QCPRDLAT);
        // Speed is very close to zero because direction changed or the rotor doesn't move fast enough
        p_speed->speedLow       = (p_qepRegs->QEPSTS.all & (EQEP_STS_CAP_OVRFLW_ERROR | EQEP_STS_CAP_DIR_ERROR)) ? (0.0) : (p_speed->speedLow);
        // Clear position event, direction change and timer overflow flags (even if direction and timer overflow are not set)
        p_qepRegs->QEPSTS.all   = EQEP_STS_UNIT_POS_EVNT | EQEP_STS_CAP_OVRFLW_ERROR | EQEP_STS_CAP_DIR_ERROR;
    }
    //-------------------------------------------------------------------
    //     INDEX HANDLING
    //-------------------------------------------------------------------
    // Check if index has been detected
    p_enc->indexDetected        = (p_qepRegs->QEPSTS.all & EQEP_STS_1ST_IDX_FLAG) ? (true) : (false);
    // Check if index has been detected
    if (p_qepRegs->QFLG.all & EQEP_INT_INDEX_EVNT_LATCH)
    {
        // Compute indexed mechanical angle normalized between 0 and 1
        p_enc->thetaIndex       = (float32_t)(p_qepRegs->QPOSILAT) / p_enc->thetaMechScaler;
        // Toggle index
        p_enc->indexToggle      = !p_enc->indexToggle;
        // Clear flag
        p_qepRegs->QCLR.all     = EQEP_INT_INDEX_EVNT_LATCH;
    }

    return;
}

/**
 * @brief           Read the position latched on ADCSOC event (generated by PWM SOC), direction \& electric position
 * @param[inout]    *p_enc  Pointer on the encoder structure.
 */
inline void ENC_getPosition(encoder_t* p_enc)
{
#ifndef UOMODRI_USE_ENC_GET_REGISTERS_FCT
    volatile struct EQEP_REGS* p_qepRegs = p_enc->p_qepRegs;
    p_enc->thetaMech[OLD]   = p_enc->thetaMech[NEW];
    // Compute mechanical angle normalized between 0 and 1
    p_enc->thetaMech[NEW]   = (float32_t)(p_qepRegs->QPOSSLAT) / p_enc->thetaMechScaler;
    // Get direction : -1 = CCW/reverse, 1 = CW/forward
    p_enc->thetaDir         = (p_qepRegs->QEPSTS.all & EQEP_STS_DIR_FLAG) ? (1) : (-1);
#endif
    // Compute electrical angle (each pole pair is normalized between 0 and 1)
    float32_t thetaElec     = p_enc->polePairs * p_enc->thetaMech[NEW];
#ifdef CM_CORE
    p_enc->thetaElec       -= (float32_t)((int32_t)thetaElec);
#else
    p_enc->thetaElec        = __fracf32(thetaElec);
#endif
}

/**
 * @brief           Encoder speed estimation
 * @param[inout]    *p_enc   Pointer on the ENCODER structure to use for speed estimate.
 */
inline void ENC_getSpeed(encoder_t* p_enc)
{
    speed_t* p_speed = &p_enc->speed;
    //-------------------------------------------------------------------
    //     HIGH SPEED ESTIMATION
    //-------------------------------------------------------------------
#ifndef UOMODRI_USE_ENC_GET_REGISTERS_FCT
    volatile struct EQEP_REGS* p_qepRegs = p_enc->p_qepRegs;

    if(p_qepRegs->QFLG.all & EQEP_INT_UNIT_TIME_OUT)
    {
        p_speed->theta[OLD]     = p_speed->theta[NEW];
        p_speed->theta[NEW]     = (float32_t)(p_qepRegs->QPOSLAT) / p_enc->thetaMechScaler;
        p_qepRegs->QCLR.all     = EQEP_INT_UNIT_TIME_OUT | EQEP_INT_OVERFLOW | EQEP_INT_UNDERFLOW;
    }
#endif
    // Compute angle difference & saturate it between -0.5 and 0.5
    float32_t deltaTheta        = p_speed->theta[NEW] - p_speed->theta[OLD];
    deltaTheta                  = (deltaTheta > 0.5f)   ? (deltaTheta - 1.0f) : (deltaTheta);
    deltaTheta                  = (deltaTheta < -0.5f)  ? (deltaTheta + 1.0f) : (deltaTheta);
    // Compute high speed estimation
    p_speed->speedHigh          = deltaTheta * p_speed->speedHighScaler;
    //-------------------------------------------------------------------
    //     LOW SPEED ESTIMATION
    //-------------------------------------------------------------------
#ifndef UOMODRI_USE_ENC_GET_REGISTERS_FCT
    // Check if unit position event occurred for low speed calculation
    if(p_qepRegs->QEPSTS.all & EQEP_STS_UNIT_POS_EVNT)
    {
        p_speed->speedLow       = (float32_t)(p_enc->thetaDir) * p_speed->speedLowScaler / (float32_t)(p_qepRegs->QCPRDLAT);
        // Speed is very close to zero because direction changed or the rotor doesn't move fast enough
        p_speed->speedLow       = (p_qepRegs->QEPSTS.all & (EQEP_STS_CAP_OVRFLW_ERROR | EQEP_STS_CAP_DIR_ERROR)) ? (0.0) : (p_speed->speedLow);
        // Clear position event, direction change and timer overflow flags (even if direction and timer overflow are not set)
        p_qepRegs->QEPSTS.all   = EQEP_STS_UNIT_POS_EVNT | EQEP_STS_CAP_OVRFLW_ERROR | EQEP_STS_CAP_DIR_ERROR;
    }
#endif
    //-------------------------------------------------------------------
    //     SPEED ESTIMATION MERGE
    //-------------------------------------------------------------------
    /*
     *
     *
     *                  Merge coefficient shape:
     * low speed     ________
     *                      |\
     *                        \
     *                      |  \
     *                          \
     *                      |    \________      w1 = 70.8 rad/s
     * high speed                |              w2 = 90.7 rad/s
     *                      w1   w2
     *
     *  High speed estimation is used for this decision because this estimation can only be lower
     */

// Compute merge coefficient // TODO as no merge is computed alpha term is not necessary
//    speedEst.alpha = FMINMAX((0.05f * (FM_ABS(speedEst.highSpeed) - SPEED_ESTIMATION_THRESHOLD)), 1.0f, 0.0f);//    speedEst.alpha = __fmin(__fmax(0.05f * (FM_ABS(speedEst.highSpeed) - SPEED_ESTIMATION_THRESHOLD), 0.0f), 1.0f);
// Compute speed reference // TODO merge high & low speed - CSDT
// see : http://www.diegm.uniud.it/petrella/Azionamenti%20Elettrici%20II/Tesine/Petrella%20et%20al.%20-%20Speed%20Measurement%20Algorithms%20for%20Low-Resolution%20Incremental%20Encoder%20Equipped%20Drives_a%20Comparative%20Analysis.pdf
    // Compute merge coefficient
    p_speed->alpha              = __fsat((float32_t)(0.05f * (fabs(p_speed->speedHigh) - SPEED_ESTIMATION_THRESHOLD)), 1.0f, 0.0f);
    p_speed->speedRef           = p_speed->speedHigh;//    p_enc->speedEst.speedRef = (1.0f - p_enc->speedEst.alpha) * p_enc->speedEst.lowMechSpeedEst + p_enc->speedEst.alpha * p_enc->speedEst.highMechSpeedEst;
    UOMODRI_SPEED_FLT(p_speed->speedFlt, p_speed->speedMech, p_speed->speedRef);
    p_speed->speedElec          = p_enc->polePairs * p_speed->speedMech;

    return;
}

/**
 * @brief           Encoder multi-turn \& index computation
 * @param[inout]    *p_enc   Pointer on the ENCODER structure to use for turn counting \index detection.
 */
inline void ENC_getTheta(encoder_t* p_enc)
{
    //-------------------------------------------------------------------
    //     TURN COMPUTATION
    //-------------------------------------------------------------------
    float32_t deltaThetaMech    = p_enc->thetaMech[NEW] - p_enc->thetaMech[OLD];
    // Update turnNb
    p_enc->turnNb               = (deltaThetaMech > 0.5f)   ? (p_enc->turnNb - 1) : (p_enc->turnNb);
    p_enc->turnNb               = (deltaThetaMech < -0.5f)  ? (p_enc->turnNb + 1) : (p_enc->turnNb);
    // If theta difference is high or low enough, we overflowed or underflowed
    bool_t maxRollOver          = (p_enc->turnNb > MAX_ROLLOVER)    ? (true) : (false);
    bool_t minRollOver          = (p_enc->turnNb < MIN_ROLLOVER)    ? (true) : (false);
    p_enc->rollOverFlag         = (maxRollOver || minRollOver)      ? (true) : (false);
    // Saturate turnNb between -128 and 127
    p_enc->turnNb               = (maxRollOver) ? (MIN_ROLLOVER) : (p_enc->turnNb);
    p_enc->turnNb               = (minRollOver) ? (MAX_ROLLOVER) : (p_enc->turnNb);
    //-------------------------------------------------------------------
    //     INDEX HANDLING
    //-------------------------------------------------------------------
#ifndef UOMODRI_USE_ENC_GET_REGISTERS_FCT
    volatile struct EQEP_REGS* p_qepRegs = p_enc->p_qepRegs;
    // Check if index has been detected
    p_enc->indexDetected        = (p_qepRegs->QEPSTS.all & EQEP_STS_1ST_IDX_FLAG) ? (true) : (false);
    // Check if index has been detected
    if (p_qepRegs->QFLG.all & EQEP_INT_INDEX_EVNT_LATCH)
    {
        // Compute indexed mechanical angle normalized between 0 and 1
        p_enc->thetaIndex       = (float32_t)(p_qepRegs->QPOSILAT) / p_enc->thetaMechScaler;
        // Toggle index
        p_enc->indexToggle      = !p_enc->indexToggle;
        // Clear flag
        p_qepRegs->QCLR.all     = EQEP_INT_INDEX_EVNT_LATCH;
    }
#endif
    // Compute indexed angle
    p_enc->thetaMechIndexed     = p_enc->thetaMech[NEW] - p_enc->thetaIndex;
    p_enc->thetaMechIndexed     = (p_enc->thetaMechIndexed < 0.0f) ? (p_enc->thetaMechIndexed + 1.0f) : (p_enc->thetaMechIndexed);
    // Compute new absolute angle
    p_enc->thetaAbsolute        = ((p_enc->indexCompensated) ? (p_enc->thetaMechIndexed) : (p_enc->thetaMech[NEW]));
    p_enc->thetaAbsolute       += (float32_t)p_enc->turnNb;

    return;
}

